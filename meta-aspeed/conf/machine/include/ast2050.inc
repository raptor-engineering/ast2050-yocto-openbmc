## meta-aspeed/conf/machine/include/ast2050.inc
```bitbake
#@TYPE: Machine
#@NAME: aspeed ast2050
#@DESCRIPTION: Machine configuration for aspeed ast2050 SoC

UBOOT_MACHINE ?= "ast2050_config"

require conf/machine/include/ast1250.inc
```

## meta-raptor/meta-asus/conf/local.conf.sample
```bitbake
#
# Local configuration file for building the OpenBMC image.
#

# Machine Selection
MACHINE ??= "asus"

# OpenBMC distro settings
DISTRO ?= "poky"
```

## meta-raptor/meta-asus/conf/machine/asus.conf
```bitbake
#@TYPE: Machine
#@NAME: ASUS
#@DESCRIPTION: Machine configuration for Raptor ASUS

UBOOT_MACHINE_asus = "asus_config"

require conf/machine/include/ast1250.inc

# configuration for preferred version of packages
PREFERRED_VERSION_libipmi = "0.1"
PREFERRED_VERSION_ipmid = "0.1"
PREFERRED_VERSION_rest-api = "0.1"

MACHINE_ESSENTIAL_EXTRA_RDEPENDS += "kernel-module-i2c-dev-sysfs"
MACHINE_ESSENTIAL_EXTRA_RDEPENDS += "kernel-module-cpld"
MACHINE_ESSENTIAL_EXTRA_RDEPENDS += "kernel-module-com-e-driver"

TCLIBC = 'eglibc'
```
